## drivers/isdn/hardware/mISDN/Kconfig
```kconfig
#
# modularer ISDN driver
#

menu "Modular ISDN driver"
	depends on NET && ISDN_BOOL && ISDN_CAPI!=n

config MISDN_DRV
	tristate "Support modular ISDN driver"
	help
	  Enable support for the modular ISDN driver.
          This driver is the successor of the famous HiSax driver.

if MISDN_DRV!=n

config MISDN_AVM_FRITZ
	bool "Support for AVM Fritz!Cards"
	depends on PCI || ISA
	help
	  Enable support for AVM Fritz!Card PCI and PnP.

config MISDN_HFCPCI
	bool "Support for HFC PCI cards"
	depends on PCI
	help
	  Enable support for card with Cologne Chips Design HFC PCI based
	  cards.

config MISDN_SPEEDFAX
	bool "Support for Sedlbauer Speedfax+"
	depends on PCI || ISA
	help
	  Enable support for Sedlbauer Speedfax+.

endif

endmenu
```

## drivers/isdn/hardware/mISDN/Kconfig.v2.6
```kconfig
#
# modularer ISDN driver
#

config MISDN_HFCPCI
	tristate "Support for HFC PCI cards"
	depends on PCI
	help
	  Enable support for card with Cologne Chips Design HFC PCI based
	  cards.

config MISDN_HFCMULTI
	tristate "Support for HFC multiport cards (HFC-4S/8S/E1)"
	depends on PCI || 8xx
	depends on MISDN
	help
	  Enable support for cards with Cologne Chip AG's HFC multiport
	  chip. There are three types of chips that are quite similar,
	  but the interface is different:
	   * HFC-4S (4 S/T interfaces on one chip)
	   * HFC-8S (8 S/T interfaces on one chip)
	   * HFC-E1 (E1 interface for 2Mbit ISDN)

config MISDN_HFCMULTI_8xx
	boolean "Support for XHFC embedded board in HFC multiport driver"
	depends on MISDN
	depends on MISDN_HFCMULTI
	depends on 8xx
	default 8xx
	help
	  Enable support for the XHFC embedded solution from Speech Design.

config MISDN_HFCUSB
	tristate "Support for HFC-S USB based TAs"
	depends on USB
	help
	  Enable support for USB ISDN TAs with Cologne Chip AG's
	  HFC-S USB ISDN Controller

config MISDN_XHFC
	tristate "Support for XHFC PCI2PI evalboard"
	depends on PCI
	help
	  Enable support for Cologne Chips AG's XHFC Evaluation Card

config MISDN_L1LOOP
        tristate "Support for virtual ISDN loop devices"
        help
          Enable support for mISDN_l1loop to use virtual ISDN devices connected
          to virtual bus system
```

## drivers/isdn/mISDN/Kconfig.v2.6
```kconfig
#
# modularer ISDN driver
#

menuconfig MISDN
	tristate "Modular ISDN driver"
	depends on NET && ISDN
	help
	  Enable support for the modular ISDN driver.

if MISDN != n

config MISDN_MEMDEBUG
	bool "Enable memory leak debug for mISDN"
	help
	  This option is for watching the use of several resources in mISDN.
	  It includes extra code to maintain list of allocated memory and
	  sk_buffs. On module unload you can see not freed resources an
	  their allocation orging and some object specific informations.
	  If unsure, say 'N'.

config MISDN_DSP
	bool "Digital Audio Processing of transparent data"
	help
	  Enable support for digital audio processing capability.
	  This module may be used for special applications that require
	  cross connecting of bchannels, conferencing, dtmf decoding
	  echo cancelation, tone generation, and Blowfish encryption and
	  decryption.
	  It may use hardware features if available.
	  E.g. it is required for PBX4Linux. Go to http://isdn.eversberg.eu
	  and get more informations about this module and it's usage.
	  If unsure, say 'N'.

config MISDN_L1OIP
	bool "ISDN over IP tunnel"
	help
	  Enable support for ISDN over IP tunnel.

	  It features:
	    - dynamic IP exchange, if one or both peers have dynamic IPs
	    - BRI (S0) and PRI (S2M) interface
	    - layer 1 control via network keepalive frames
	    - direct tunneling of physical interface via IP

	  NOTE: This protocol is called 'Layer 1 over IP' and is not
	  compatible with ISDNoIP (Agfeo) or TDMoIP. Protocol description is
	  provided in the source code.

	source "drivers/isdn/hardware/mISDN/Kconfig"
endif #MISDN
```
